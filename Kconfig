## Kconfig
```kconfig
#
# Copyright (c) 2020 Nordic Semiconductor ASA
#
# SPDX-License-Identifier: LicenseRef-Nordic-5-Clause
#

menu "UDP Sample Settings"

config UDP_DATA_UPLOAD_SIZE_BYTES
	int "Number of bytes transmitted to the server"
	default 120

config UDP_DATA_UPLOAD_FREQUENCY_SECONDS
	int "How often data is transmitted to the server"
	default 300

config UDP_SERVER_ADDRESS_STATIC
	string "UDP server IP address"
	default "192.168.1.2"

config UDP_SERVER_PORT
	int "UDP server port number"
	default "1234"

config UDP_PSM_ENABLE
	bool "Enable LTE Power Saving Mode"
	default y

config UDP_EDRX_ENABLE
	bool "Enable LTE enhanced Discontinuous Reception"

config UDP_RAI_ENABLE
	bool "Enable LTE Release Assistance Indication"

endmenu

module = UDP
module-str = UDP sample
source "${ZEPHYR_BASE}/subsys/logging/Kconfig.template.log_config"

menu "Zephyr Kernel"
source "Kconfig.zephyr"
endmenu
```

## boards/arm/sco-ltem1wlm_nrf9160/Kconfig.board
```kconfig
# Sakura Internet SCM-LTEM1NRF board configuration

# Copyright (c) 2018-2020 Nordic Semiconductor ASA
# SPDX-License-Identifier: Apache-2.0

if SOC_NRF9160_SICA

config BOARD_SCM_LTEM1NRF_NRF9160
	bool "Sakura Internet SCM-LTEM1NRF"

config BOARD_SCM_LTEM1NRF_NRF9160_NS
	bool "Sakura Internet SCM-LTEM1NRF non-secure"

endif # SOC_NRF9160_SICA
```
